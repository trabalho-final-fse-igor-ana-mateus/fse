## main/Kconfig.projbuild
```kconfig
menu "Configuração do Wifi Configuration"

    config ESP_WIFI_SSID
        string "WiFi SSID"
        default "ssid"
        help
            Nome da rede Wifi.

    config ESP_WIFI_PASSWORD
        string "Senha do Wifi"
        default "minha_senha"
        help
            Senha do WiFi (WPA or WPA2).

    config ESP_MAXIMUM_RETRY
        int "Número máximo de tentativas de conexão"
        default 5
        help
            Configure o valor máximo de tentativas de conexão.
endmenu

menu "Configuração dos sensores"

    config TEMPERATURE_SENSOR_PIN
        int "Pino sensor de temperatura e umidade"
        default -1
        help
            Pino do sensor de temperatura e umidade.

    config FLAME_DETECTOR_PIN
        int "Pino sensor de chama"
        default -1
        help
            Pino do sensor de detecção de chama.

    config SOUND_DETECTOR_PIN
        int "Pino sensor de som"
        default -1
        help
            Pino do sensor de detecção de som.

    config LASER_PIN
        int "Pino laser"
        default -1
        help
            Pino do laser.
endmenu
```
